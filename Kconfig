## Kconfig
```kconfig
# Zephyr 4.1 BT_ECC selects the ECC key-pair operations but omits the public
# key prerequisite enforced by the pinned NCS 3.1.1 Oberon core.
config TOTEM_NCS_BLE_ECC_PUBLIC_KEY_COMPAT
    bool
    default y
    depends on NRF_SECURITY && BT_ECC
    select PSA_WANT_KEY_TYPE_ECC_PUBLIC_KEY

menu "Totem ESB compatibility and benchmark"

config TOTEM_ESB_COMPAT
    bool "Apply the pinned Totem ESB compatibility patch"
    depends on ZMK_SPLIT_ESB
    default n
    help
      Applies the small compatibility layer for the exact ESB and Prospector
      revisions pinned in config/west.yml.

config TOTEM_ESB_PROSPECTOR
    bool "Enable Prospector ESB peer status integration"
    depends on TOTEM_ESB_COMPAT && ZMK_SPLIT_ROLE_CENTRAL
    default n

config TOTEM_ESB_V3
    bool "Enable authenticated/encrypted Totem ESB v3 transport"
    depends on TOTEM_ESB_COMPAT
    default n
    help
      Replaces the v2 CRC32 postfix with AES-128-CCM encryption and a
      BLE-sized 4-byte MIC. A two-nonce authenticated handshake establishes
      a fresh session before ZMK events or commands are accepted.

config TOTEM_ESB_V3_CI_TEST_KEYS
    bool "Use public disposable ESB v3 CI test keys"
    depends on TOTEM_ESB_V3
    default n
    help
      Enables keys that are public in this repository. Firmware built with
      this option is only for compile/protocol testing and is not secure.

config TOTEM_ESB_V3_LOCAL_KEY_HEX
    string "ESB v3 local peripheral link key (32 hex characters)"
    depends on TOTEM_ESB_V3 && !ZMK_SPLIT_ROLE_CENTRAL
    default "4d4f5d2cd993c6be0db2495606d229a1" if TOTEM_ESB_V3_CI_TEST_KEYS && SHIELD_TOTEM_ESB_LEFT
    default "ed812b6ff48a2e17328b623983cb776c" if TOTEM_ESB_V3_CI_TEST_KEYS && SHIELD_TOTEM_ESB_RIGHT
    default ""

config TOTEM_ESB_V3_LEFT_KEY_HEX
    string "ESB v3 dongle-to-left link key (32 hex characters)"
    depends on TOTEM_ESB_V3 && ZMK_SPLIT_ROLE_CENTRAL
    default "4d4f5d2cd993c6be0db2495606d229a1" if TOTEM_ESB_V3_CI_TEST_KEYS
    default ""

config TOTEM_ESB_V3_RIGHT_KEY_HEX
    string "ESB v3 dongle-to-right link key (32 hex characters)"
    depends on TOTEM_ESB_V3 && ZMK_SPLIT_ROLE_CENTRAL
    default "ed812b6ff48a2e17328b623983cb776c" if TOTEM_ESB_V3_CI_TEST_KEYS
    default ""

config TOTEM_ESB_V3_HANDSHAKE_INTERVAL_MS
    int "ESB v3 handshake probe interval in milliseconds"
    depends on TOTEM_ESB_V3
    default 2
    range 1 100

config TOTEM_ESB_V3_SESSION_OK_TIMEOUT_MS
    int "ESB v3 SESSION_OK wait timeout in milliseconds"
    depends on TOTEM_ESB_V3 && !ZMK_SPLIT_ROLE_CENTRAL
    default 2000
    range 250 30000
    help
      Starts a fresh HELLO with a new boot nonce if the peripheral remains
      in WAIT_SESSION_OK for this long. This recovers after the central has
      discarded a pending key during an extended RF outage.

config TOTEM_ESB_V3_PENDING_TIMEOUT_MS
    int "ESB v3 central pending-session timeout in milliseconds"
    depends on TOTEM_ESB_V3 && ZMK_SPLIT_ROLE_CENTRAL
    default 2000
    range 250 30000
    help
      Discards an unconfirmed central pending key after this interval. This
      prevents one replayed HELLO or RECOVERY from pinning the handshake
      forever while still keeping a MIC-failure reset transcript fixed
      during the bounded recovery window.

config TOTEM_ESB_V3_PRESESSION_EVENT_QUEUE_SIZE
    int "Events retained while an ESB v3 session is negotiated"
    depends on TOTEM_ESB_V3 && !ZMK_SPLIT_ROLE_CENTRAL
    default 32
    range 8 128

config TOTEM_ESB_HEARTBEAT_INTERVAL_MS
    int "Peripheral heartbeat interval in milliseconds"
    depends on TOTEM_ESB_COMPAT
    default 250
    range 50 5000

config TOTEM_ESB_PEER_TIMEOUT_MS
    int "Central peer timeout in milliseconds"
    depends on TOTEM_ESB_COMPAT && ZMK_SPLIT_ROLE_CENTRAL
    default 1500
    range 250 30000

config TOTEM_ESB_BENCHMARK
    bool "Enable ESB sequence/latency benchmark logging"
    depends on TOTEM_ESB_COMPAT
    default n

config TOTEM_ESB_BENCHMARK_PERIOD_US
    int "Synthetic benchmark packet period in microseconds"
    depends on TOTEM_ESB_BENCHMARK
    default 1000
    range 500 1000000

config TOTEM_ESB_BENCHMARK_ZERO_DEBOUNCE
    bool "Use zero debounce in a benchmark-only auxiliary shield"
    depends on TOTEM_ESB_BENCHMARK
    default n

endmenu
```

## config/boards/shields/totem/Kconfig.defconfig
```kconfig
# Copyright (c) 2022 The ZMK Contributors
# SPDX-License-Identifier: MIT

if SHIELD_TOTEM_DONGLE

config ZMK_KEYBOARD_NAME
    default "TOTEM"
    
config ZMK_SPLIT_ROLE_CENTRAL
    default y

config ZMK_USB
    default y

endif

if SHIELD_TOTEM_LEFT || SHIELD_TOTEM_RIGHT || SHIELD_TOTEM_DONGLE

config ZMK_SPLIT
    default y

config ZMK_BLE
    default y

endif

if (SHIELD_TOTEM_LEFT || SHIELD_TOTEM_RIGHT || SHIELD_TOTEM_DONGLE) && ZMK_BLE

choice BT_CTLR_TX_PWR
    default BT_CTLR_TX_PWR_PLUS_8
endchoice

config BT_CTLR_PHY_2M
    default n

endif

if SHIELD_TOTEM_ESB_DONGLE

config ZMK_KEYBOARD_NAME
    default "TOTEM V3 TEST" if SHIELD_TOTEM_ESB_V3 && TOTEM_ESB_V3_CI_TEST_KEYS
    default "TOTEM V3" if SHIELD_TOTEM_ESB_V3
    default "TOTEM ESB"

config ZMK_SPLIT_ROLE_CENTRAL
    default y

config ZMK_USB
    default y

endif

if SHIELD_TOTEM_ESB_LEFT || SHIELD_TOTEM_ESB_RIGHT || SHIELD_TOTEM_ESB_DONGLE

config ZMK_SPLIT
    default y

endif
```

## config/boards/shields/totem/Kconfig.shield
```kconfig
# Copyright (c) 2022 The ZMK Contributors
# SPDX-License-Identifier: MIT

config SHIELD_TOTEM_LEFT
    def_bool $(shields_list_contains,totem_left)

config SHIELD_TOTEM_RIGHT
    def_bool $(shields_list_contains,totem_right)

config SHIELD_TOTEM_DONGLE
    def_bool $(shields_list_contains,totem_dongle)

config SHIELD_TOTEM_ESB_LEFT
    def_bool $(shields_list_contains,totem_esb_left)

config SHIELD_TOTEM_ESB_RIGHT
    def_bool $(shields_list_contains,totem_esb_right)

config SHIELD_TOTEM_ESB_DONGLE
    def_bool $(shields_list_contains,totem_esb_dongle)

config SHIELD_TOTEM_ESB_BENCHMARK
    def_bool $(shields_list_contains,totem_esb_benchmark)

config SHIELD_TOTEM_ESB_V3
    def_bool $(shields_list_contains,totem_esb_v3)
```

## config/west.yml
```yaml
manifest:
  remotes:
    - name: zmkfirmware
      url-base: https://github.com/zmkfirmware
    - name: carrefinho
      url-base: https://github.com/carrefinho
    - name: urob
      url-base: https://github.com/urob
    - name: badjeff
      url-base: https://github.com/badjeff
    - name: nrfconnect
      url-base: https://github.com/nrfconnect
  projects:
    - name: zmk
      remote: zmkfirmware
      revision: 904c9aec8822d79149d42c8a9a77e8828eb08f5a
      import: app/west.yml
    # Main-manifest definitions override same-named imported projects. Keep
    # this after ZMK so ZMK's explicit LVGL/HAL overrides are resolved before
    # the pinned Zephyr project's own imported dependency manifest.
    - name: zephyr
      remote: zmkfirmware
      revision: 9df4b12b5af3438a8b9d7a33780dc3b3b2f516c1
      clone-depth: 1
      import:
        name-blocklist:
          - ci-tools
          - hal_altera
          - hal_cypress
          - hal_infineon
          - hal_microchip
          - hal_nxp
          - hal_openisa
          - hal_xtensa
          - hal_st
          - hal_ti
          - loramac-node
          - mcuboot
          - mcumgr
          - net-tools
          - openthread
          - edtt
          - trusted-firmware-m
    - name: zmk-feature-split-esb
      remote: badjeff
      revision: 1f4cd4558bb9e0626ec2507f334f239862af859d
    - name: sdk-nrf
      remote: badjeff
      revision: 9b3d2623fdcd9c0fd0284f860beea924568c9826
      path: nrf
    - name: nrfxlib
      remote: nrfconnect
      repo-path: sdk-nrfxlib
      revision: dfadf17305d8f000eda9aa74a5b9ff1c5647a23e
      path: nrfxlib
    - name: prospector-zmk-module
      remote: carrefinho
      revision: ed98221f3b52b7066dbb10ba3af8a29150b93a5a
    - name: zmk-tri-state
      remote: urob
      revision: 2007896c6d5bfb519e8babccf8633841c5647d8b
      path: modules/zmk/tri-state
  self:
    path: config
```

## dts/bindings/behaviors/totem,behavior-auto-base.yaml
```yaml
# Copyright (c) 2026 The Totem Contributors
# SPDX-License-Identifier: MIT

description: Synchronously tap an encoded key and return to Base layer zero

compatible: "totem,behavior-auto-base"

include: one_param.yaml
```

## dts/bindings/behaviors/totem,behavior-mouse-move.yaml
```yaml
# Copyright (c) 2024 The ZMK Contributors
# SPDX-License-Identifier: MIT

description: Cursor movement with a delayed acceleration boost

compatible: "totem,behavior-mouse-move"

include: one_param.yaml

properties:
  x-input-code:
    type: int
    required: true
  y-input-code:
    type: int
    required: true
  trigger-period-ms:
    type: int
    default: 16
    description: The time (in ms) between generated inputs when an input has non-zero speed.
  delay-ms:
    type: int
  time-to-max-speed-ms:
    type: int
    required: true
  acceleration-exponent:
    type: int
    default: 1
  acceleration-boost-start-ms:
    type: int
    default: 0
    description: Time before the additional speed curve begins.
  acceleration-boost-numerator:
    type: int
    default: 1
    description: Numerator of the final speed multiplier, at least the denominator.
  acceleration-boost-denominator:
    type: int
    default: 1
    description: Positive denominator of the final speed multiplier.
  fast-layer:
    type: int
    default: -1
    description: Layer ID for constant fast movement, or -1 to disable. Wins over precise-layer.
  precise-layer:
    type: int
    default: -1
    description: Layer ID for constant precise movement, or -1 to disable.
  fast-speed:
    type: array
    default: [1, 1]
    description: Positive numerator and denominator of absolute fast movement units per second.
  precise-speed:
    type: array
    default: [1, 1]
    description: Positive numerator and denominator of absolute precise movement units per second.
```

## dts/bindings/behaviors/totem,behavior-owned-swapper.yaml
```yaml
# SPDX-License-Identifier: MIT

description: Owned Alt-Tab swapper with direct release

compatible: "totem,behavior-owned-swapper"

include: zero_param.yaml

properties:
  ignored-key-positions:
    type: array
    required: true
```
