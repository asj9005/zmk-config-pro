/*
 * Address generated for this Totem set on 2026-07-29.
 *
 * This is a collision-avoidance identifier, not an encryption key.
 * All three ESB roles must include this one file.
 */

/ {
    esb_split {
        compatible = "zmk,esb-split";
        base-addr-0 = <0x3B 0xF1 0x26 0x68>;
        base-addr-1 = <0xFB 0xA3 0xA7 0x62>;
        /*
         * Pipe 0 is reserved. Pipes 1/2 carry left/right PTX data and the
         * corresponding reverse-direction PRX ACK-payload commands.
         */
        addr-prefix = <0x69 0xD4 0x8A>;
    };
};
